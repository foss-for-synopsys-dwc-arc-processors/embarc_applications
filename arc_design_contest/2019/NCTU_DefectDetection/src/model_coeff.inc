// AUTO GENERATED FILE

#include "embarc_mli_sections.h"

//   CONV1_W constants
//======================================================
const int8_t _W L1_conv1_wt_buf[] = { \
	  58, -26, -61,  47, -33, -34, -66,  66,   0, -66,  24,  -8,  25, -40,  42,  34, -22,  69, -60, -15, -53,  22,  -5,  30,  89,  74,  76, -15,  73,  73,  49,   5,\
	  41,  28,   7,  80,  83,   5,  61,  12,  71,  -2,  36,  53,  89, -36, -48,   3, -12, -23, -63,  51,  63, -61, -71,  26,  35,  41, -67,  -3, -38, -13,  25,  41,\
	 -50, -59, -64,  51, -41, -41, -37, -35, -57,  32,  19, -61, -60,  46,   8,  21, -13, -33, -51,  55, -67, -68, -45,  34,  47,  28,  44, -42,  29,  59,  -9, -58,\
	 -57,  31, -25, -50, -73,  65, -65, -55,  58,  26,   6,  71,  -9,  38,  -5,  46, -29, -53, -38,  34, -36,  44,  57,  12,  -6,  -5, -63, -40, -34,  61, -19,  50,\
	  42, -17, -15,  -5, -35, -66,  13,   9,  11,  85,  60, -20,  94,  83,  85,  11};

//   CONV1_B constants
//======================================================
const int8_t _W L1_conv1_b_buf[] = { \
	  28,  36,  45, -28, -74,  -7, -20,  -2,  21,  39,  37,  89,  -6,  32,  -6, -53};

//   CONV2_W constants
//======================================================
const int8_t _W L2_conv2_wt_buf[] = { \
	   6,  -9, -28,  -6,  29,  34, -31,  13, -23,  -2, -23,   3,  -7, -31, -16,  11, -26, -38,  24,  58,  49,  -8, -12,  27, -13,   8, -30,  51,  34,  64,  62,  63,\
	   1,  23,  -4, -23,  16,  69,  69,  65,  67,  -5,  48,  14,  23,  -7,  31,  36,  21, -25,  -3, -10, -20,  13,  -7,  -7,  29,   9,  20,  33, -21,  17,  22,  10,\
	  32, -30,  -4,  34,   8,  18, -26,  23,  20, -27, -27, -24,   7, -23,  36, -19, -17,  25, -30,   2, -19, -42,  22,  -3,  13,  34, -40,  -2,  34, -32, -17,  26,\
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	 -26,  21,  35,  21, -36, -36,  11,  20, -23,  24,  -4,   2, -32,  11,  14, -12,  -7,  -8, -16,  -1,   7, -13,  19,  16,  30,   7,  -3, -10,  -4,  34, -17,  -5};

//   CONV2_B constants
//======================================================
const int8_t _W L2_conv2_b_buf[] = { \
	 -48,  52,   6, -27, -20,  12,  92,   1,  72,  24,  32, -23,  -2, -43, -30,  18};

//   FC4_W constants
//======================================================
const int8_t _W2 L3_fc4_wt_buf[] = { \
	  19, -31,   1, -27,   3, -25, -20, -44, -26,  18, -35, -55,  -5,  -1, -30, -14,  22,  -8, -10,  19,  53,  20,  66,  64,  53,  -3,   9,  82,  25,  28,  16,  15,\
	  67,  -9, -20, -13,  -9, -12,   8,  -2, -30, -10,  40,   0, -26,  16, -19,   9, -23, -11,   5,  -1, -27, -19,  20,  10, -15,   2,  18, -27,  23,   8,  -6,   9,\
	  31,   2, -16,  -8,  36,  34,  -4,  17,   8,   1, -22, -32,  17,  28,  21,  -6,  19,  -7,  13,   7, -28,   2,   4, -34, -31,   3,  27, -18,  -4,  13,   1, -11,\
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	   8, -16,  19, -10, -20,  13,   5, -18, -23, -19,  -4,   4,  14, -20, -29,  26,   7,   1,   5,  12,   1, -12,  12,  26, -27,  30,  20, -16, -15, -21,   1,  28};

//   FC4_B constants
//======================================================
const int8_t _W2 L3_fc4_b_buf[] = { \
	 120,   3,   0,   3, -15, -97,  22, -16,   0,  -2, -15, -25, -77, -63,  13,  -2};

//   FC5_W constants
//======================================================
const int8_t _W2 L4_fc5_wt_buf[] = { \
	 -73,  43,  37,   3, -48,  11, -54, 103,   5,   8, -81, -57,  69,  53,  17, -41,  28, -45,  26,  72, -19,  69,  68, -81, -39,  23,  21,  16,-100, -65,  72, -35};

//   FC5_B constants
//======================================================
const int8_t _W2 L4_fc5_b_buf[] = { \
	  72, -72};

